## arch/arm/config.in
```kconfig
#
# For a description of the syntax of this configuration file,
# see Documentation/kbuild/config-language.txt.
#
mainmenu_name "ARM Linux Kernel Configuration"

define_bool CONFIG_ARM y
define_bool CONFIG_EISA n
define_bool CONFIG_SBUS n
define_bool CONFIG_MCA n
define_bool CONFIG_UID16 y
define_bool CONFIG_RWSEM_GENERIC_SPINLOCK y
define_bool CONFIG_RWSEM_XCHGADD_ALGORITHM n
define_bool CONFIG_GENERIC_BUST_SPINLOCK n
define_bool CONFIG_GENERIC_ISA_DMA n

mainmenu_option next_comment
comment 'Code maturity level options'
bool 'Prompt for development and/or incomplete code/drivers' CONFIG_EXPERIMENTAL
bool 'Prompt for obsolete code/drivers' CONFIG_OBSOLETE
endmenu


mainmenu_option next_comment
comment 'Loadable module support'
bool 'Enable loadable module support' CONFIG_MODULES
dep_bool '  Set version information on all module symbols' CONFIG_MODVERSIONS $CONFIG_MODULES
dep_bool '  Kernel module loader' CONFIG_KMOD $CONFIG_MODULES
endmenu


mainmenu_option next_comment
comment 'System Type'

choice 'ARM system type' \
	"Anakin			CONFIG_ARCH_ANAKIN \
	 Archimedes/A5000	CONFIG_ARCH_ARCA5K \
	 Cirrus-CL-PS7500FE     CONFIG_ARCH_CLPS7500 \
 	 CLPS711x/EP721x-based	CONFIG_ARCH_CLPS711X \
	 Co-EBSA285		CONFIG_ARCH_CO285 \
	 EBSA-110		CONFIG_ARCH_EBSA110 \
 	 Excalibur-ARM          CONFIG_ARCH_CAMELOT \
	 FootBridge		CONFIG_ARCH_FOOTBRIDGE \
	 Integrator		CONFIG_ARCH_INTEGRATOR \
	 SSA			CONFIG_ARCH_SSA \
	 Omaha			CONFIG_ARCH_OMAHA \
	 LinkUp-L7200		CONFIG_ARCH_L7200 \
	 Motorola-MX1ADS        CONFIG_ARCH_MX1ADS \
	 PNX0106		CONFIG_ARCH_PNX0106 \
	 RiscPC			CONFIG_ARCH_RPC \
	 RiscStation		CONFIG_ARCH_RISCSTATION \
	 SA1100-based		CONFIG_ARCH_SA1100 \
	 Shark			CONFIG_ARCH_SHARK \
	 AT91RM9200-based	CONFIG_ARCH_AT91RM9200 " RiscPC

if [ "$CONFIG_ARCH_SSA" = "y" ]
then
   mainmenu_option next_comment
   comment 'SSA Implementations'
   dep_bool '  Original SIIG demoboard' CONFIG_SSA_SIIG $CONFIG_ARCH_SSA
   dep_bool '  Tahoe development board' CONFIG_SSA_TAHOE $CONFIG_ARCH_SSA
   dep_bool '  WessLi' CONFIG_SSA_WESSLI $CONFIG_ARCH_SSA
   dep_bool '  W3 (SAA7752 cpu + AX88796 + FIFO-less pccard/16bit interface)' CONFIG_SSA_W3 $CONFIG_ARCH_SSA
   dep_tristate '    Enable CPLD pccard interface driver' CONFIG_SSA_W3_PCCARD $CONFIG_SSA_W3
   dep_tristate '    Enable CPLD 16bit GPI interface driver' CONFIG_SSA_W3_GPI $CONFIG_SSA_W3
   dep_tristate '    Enable CPLD SPI interface driver' CONFIG_SSA_W3_SPI $CONFIG_SSA_W3
   dep_bool '  HAS (SAA7750 cpu)' CONFIG_SSA_HAS7750 $CONFIG_ARCH_SSA
   dep_bool '    Use HAS7750 custom IDE driver' CONFIG_SSA_HAS7750_CUSTOM_IDE $CONFIG_SSA_HAS7750
   dep_bool '  HAS (SAA7752 cpu)' CONFIG_SSA_HAS7752 $CONFIG_ARCH_SSA
   dep_bool '    Use HAS7752 custom IDE driver' CONFIG_SSA_HAS7752_CUSTOM_IDE $CONFIG_SSA_HAS7752
   dep_bool '    Enable USB Mass Storage driver' CONFIG_SSA_HAS7752_USBDEV $CONFIG_SSA_HAS7752
   dep_tristate '    Enable simple pccard test module' CONFIG_SSA_HAS7752_PCCARD_TEST $CONFIG_SSA_HAS7752
   dep_bool '    Enable DP-RAM driver' CONFIG_SSA_HAS7752_DPRAM $CONFIG_SSA_HAS7752
   endmenu
   
   if [ "$CONFIG_SSA_HAS7752" = "y" -a "$CONFIG_SSA_HAS7750_CUSTOM_IDE" != "y" ]
   then
   	define_bool CONFIG_BLK_DEV_IDEDMA y
   fi
fi

if [ "$CONFIG_ARCH_PNX0106" = "y" ]
then
   mainmenu_option next_comment
   comment 'PNX0106 HW platforms'
   dep_bool '  Nijmegen GH526 development board' CONFIG_PNX0106_GH526 $CONFIG_ARCH_PNX0106
   dep_bool '  WSA development board' CONFIG_PNX0106_WSA $CONFIG_ARCH_PNX0106
   dep_bool '  SIIG Laguna Rev A development board' CONFIG_PNX0106_LAGUNA_REVA $CONFIG_ARCH_PNX0106
   dep_bool '  WessLi-6 AHub board' CONFIG_PNX0106_W6 $CONFIG_ARCH_PNX0106
   dep_bool '  WMA-100 board' CONFIG_PNX0106_WMA100 $CONFIG_ARCH_PNX0106
   dep_bool '  LPAS1 board' CONFIG_PNX0106_LPAS1 $CONFIG_ARCH_PNX0106
   dep_bool '  LDMA1 board' CONFIG_PNX0106_LDMA1 $CONFIG_ARCH_PNX0106
   dep_bool '  RSS1 board' CONFIG_PNX0106_RSS1 $CONFIG_ARCH_PNX0106
   dep_bool '  RSC1 board' CONFIG_PNX0106_RSC1 $CONFIG_ARCH_PNX0106
   dep_bool '  HasLi-7 AHub board' CONFIG_PNX0106_HASLI7 $CONFIG_ARCH_PNX0106
   dep_bool '  HacLi-7 AHub board' CONFIG_PNX0106_HACLI7 $CONFIG_ARCH_PNX0106
   dep_bool '  HasLi-7 AHub board' CONFIG_PNX0106_MCIH $CONFIG_ARCH_MCIH
   dep_bool '  HacLi-7 AHub board' CONFIG_PNX0106_MCI $CONFIG_ARCH_MCI
   comment 'PNX0106 specific options'
   dep_bool '  Enable 10bit ADC driver' CONFIG_PNX0106_ADC $CONFIG_ARCH_PNX0106
   dep_bool '  Enable BLAS SPI interface driver' CONFIG_PNX0106_BLAS_SPI $CONFIG_ARCH_PNX0106
   dep_bool '  Enable BLAS SPI interface driver (SD Card compatible API)' CONFIG_PNX0106_BLAS_SPISD $CONFIG_ARCH_PNX0106
   dep_bool '  Enable CPLD based 16bit PCCARD interface driver' CONFIG_PNX0106_PCCARD_CPLD $CONFIG_ARCH_PNX0106
   dep_bool '  Enable ECO-Standby support' CONFIG_PNX0106_ECOSTANDBY $CONFIG_ARCH_PNX0106
   dep_bool '    ECO-Standby LCD Backlight control' CONFIG_PNX0106_ECOSTANDBY_LCD_BACKLIGHT_CONTROL $CONFIG_PNX0106_ECOSTANDBY
   dep_bool '      ECO-Standby LCD Backlight control - Off high' CONFIG_PNX0106_ECOSTANDBY_LCD_BACKLIGHT_OFF_HIGH $CONFIG_PNX0106_ECOSTANDBY_LCD_BACKLIGHT_CONTROL
   dep_bool '  Enable Epics DSP driver' CONFIG_PNX0106_EPICS $CONFIG_ARCH_PNX0106
   dep_bool '  Enable Epics DSP AAC driver' CONFIG_PNX0106_EPICS_AAC $CONFIG_PNX0106_EPICS
   dep_bool '  Enable Epics DSP MP3 driver' CONFIG_PNX0106_EPICS_MP3 $CONFIG_PNX0106_EPICS
   dep_bool '  Enable Epics DSP WMA driver' CONFIG_PNX0106_EPICS_WMA $CONFIG_PNX0106_EPICS
   dep_bool '  Enable LCD interface access wrapper' CONFIG_PNX0106_LCDIF_WRAPPER $CONFIG_ARCH_PNX0106
   dep_bool '  Enable onchip 16bit PCCARD interface driver' CONFIG_PNX0106_PCCARD $CONFIG_ARCH_PNX0106
   dep_bool '  Enable TSC access driver' CONFIG_PNX0106_TSCDEV $CONFIG_ARCH_PNX0106
   dep_bool '  Enable USB2 EHCI OTG complaint core' CONFIG_USB_EHCI_PNX0106 $CONFIG_ARCH_PNX0106
   endmenu
fi

mainmenu_option next_comment
comment 'Archimedes/A5000 Implementations'
# These architectures will be combined.  However, until this
# is complete...  Note that the ARC will take precedence over
# A5K
comment 'Archimedes/A5000 Implementations (select only ONE)'
dep_bool '  Archimedes' CONFIG_ARCH_ARC $CONFIG_ARCH_ARCA5K
dep_bool '  A5000' CONFIG_ARCH_A5K $CONFIG_ARCH_ARCA5K
endmenu

mainmenu_option next_comment
comment 'Footbridge Implementations'
dep_bool '  CATS' CONFIG_ARCH_CATS $CONFIG_ARCH_FOOTBRIDGE
dep_bool '  Compaq Personal Server' CONFIG_ARCH_PERSONAL_SERVER $CONFIG_ARCH_FOOTBRIDGE
dep_bool '  EBSA285 (addin mode)' CONFIG_ARCH_EBSA285_ADDIN $CONFIG_ARCH_FOOTBRIDGE
dep_bool '  EBSA285 (host mode)' CONFIG_ARCH_EBSA285_HOST $CONFIG_ARCH_FOOTBRIDGE
dep_bool '  NetWinder' CONFIG_ARCH_NETWINDER $CONFIG_ARCH_FOOTBRIDGE
endmenu

mainmenu_option next_comment
comment 'SA11x0 Implementations'
dep_bool '  ACCELENT DevBoard' CONFIG_SA1100_ACCELENT $CONFIG_ARCH_SA1100
dep_bool '  Assabet' CONFIG_SA1100_ASSABET $CONFIG_ARCH_SA1100
dep_bool '    Include support for Neponset' CONFIG_ASSABET_NEPONSET $CONFIG_SA1100_ASSABET
dep_bool '  ADS Advanced Graphics Client' CONFIG_SA1100_ADSAGC $CONFIG_ARCH_SA1100
dep_bool '  ADS Bitsy' CONFIG_SA1100_ADSBITSY $CONFIG_ARCH_SA1100
dep_bool '  ADS Bitsy Plus' CONFIG_SA1100_ADSBITSYPLUS $CONFIG_ARCH_SA1100
dep_bool '  Brutus' CONFIG_SA1100_BRUTUS $CONFIG_ARCH_SA1100
dep_bool '  Cep' CONFIG_SA1100_CEP $CONFIG_ARCH_SA1100
dep_bool '  CerfBoard' CONFIG_SA1100_CERF $CONFIG_ARCH_SA1100
if [ "$CONFIG_SA1100_CERF" = "y" ]; then
   choice 'Cerf RAM available' \
        "8MB   CONFIG_SA1100_CERF_8MB \
         16MB   CONFIG_SA1100_CERF_16MB \
         32MB   CONFIG_SA1100_CERF_32MB \
         64MB   CONFIG_SA1100_CERF_64MB" CerfRam
   choice 'Cerf Flash available'  \
        "8MB    CONFIG_SA1100_CERF_FLASH_8MB \
         16MB   CONFIG_SA1100_CERF_FLASH_16MB \
         32MB   CONFIG_SA1100_CERF_FLASH_32MB" 8MB
   bool 'Cerf w/CPLD support (CerfPDA)' CONFIG_SA1100_CERF_CPLD
fi
dep_bool '  Compaq iPAQ H3100' CONFIG_SA1100_H3100 $CONFIG_ARCH_SA1100
dep_bool '  Compaq iPAQ H3600/H3700' CONFIG_SA1100_H3600 $CONFIG_ARCH_SA1100
dep_bool '  Compaq iPAQ H3800' CONFIG_SA1100_H3800 $CONFIG_ARCH_SA1100
if [ "$CONFIG_SA1100_H3100" = "y" -o "$CONFIG_SA1100_H3600" = "y" -o "$CONFIG_SA1100_H3800" = "y" ]; then
  define_bool CONFIG_SA1100_H3XXX y
else
  define_bool CONFIG_SA1100_H3XXX n
fi
dep_tristate 'Compaq iPAQ Handheld sleeve support' CONFIG_H3600_SLEEVE $CONFIG_SA1100_H3600
#dep_bool '  Consus' CONFIG_SA1100_CONSUS $CONFIG_ARCH_SA1100
#dep_bool '  Empeg' CONFIG_SA1100_EMPEG $CONFIG_ARCH_SA1100
dep_bool '  Extenex HandHeld Theater (Squashtail)' CONFIG_SA1100_EXTENEX1 $CONFIG_ARCH_SA1100
if [ "$CONFIG_SA1100_EXTENEX1" = "y" ]; then
   bool '    Support 16 MB of DRAM (not just 8)' CONFIG_SA1100_EXTENEX1_16MB
fi
dep_bool '  FlexaNet' CONFIG_SA1100_FLEXANET $CONFIG_ARCH_SA1100
dep_bool '  FreeBird-v1.1' CONFIG_SA1100_FREEBIRD $CONFIG_ARCH_SA1100
dep_bool '  Frodo' CONFIG_SA1100_FRODO $CONFIG_ARCH_SA1100
dep_bool '  GraphicsClient Plus' CONFIG_SA1100_GRAPHICSCLIENT $CONFIG_ARCH_SA1100
dep_bool '  GraphicsMaster' CONFIG_SA1100_GRAPHICSMASTER $CONFIG_ARCH_SA1100
dep_bool '  HackKit Core Board' CONFIG_SA1100_HACKKIT $CONFIG_ARCH_SA1100
dep_bool '  HP Labs BadgePAD 4' CONFIG_SA1100_BADGE4 $CONFIG_ARCH_SA1100
dep_bool '  HP Jornada 720' CONFIG_SA1100_JORNADA720 $CONFIG_ARCH_SA1100
dep_bool '  HuW WebPanel' CONFIG_SA1100_HUW_WEBPANEL $CONFIG_ARCH_SA1100
dep_bool '  Itsy' CONFIG_SA1100_ITSY $CONFIG_ARCH_SA1100
dep_bool '  LART' CONFIG_SA1100_LART $CONFIG_ARCH_SA1100
dep_bool '  nanoEngine' CONFIG_SA1100_NANOENGINE $CONFIG_ARCH_SA1100
dep_bool '  OmniMeter' CONFIG_SA1100_OMNIMETER $CONFIG_ARCH_SA1100
dep_bool '  Pangolin' CONFIG_SA1100_PANGOLIN $CONFIG_ARCH_SA1100
dep_bool '  PLEB' CONFIG_SA1100_PLEB $CONFIG_ARCH_SA1100
dep_bool '  PT System 3' CONFIG_SA1100_PT_SYSTEM3 $CONFIG_ARCH_SA1100
dep_bool '  Shannon' CONFIG_SA1100_SHANNON $CONFIG_ARCH_SA1100
dep_bool '  Sherman' CONFIG_SA1100_SHERMAN $CONFIG_ARCH_SA1100
dep_bool '  Simpad' CONFIG_SA1100_SIMPAD $CONFIG_ARCH_SA1100
dep_bool '  Simputer' CONFIG_SA1100_SIMPUTER $CONFIG_ARCH_SA1100
dep_bool '  Tulsa' CONFIG_SA1100_PFS168 $CONFIG_ARCH_SA1100
dep_bool '  Victor' CONFIG_SA1100_VICTOR $CONFIG_ARCH_SA1100
dep_bool '  XP860' CONFIG_SA1100_XP860 $CONFIG_ARCH_SA1100
dep_bool '  Yopy' CONFIG_SA1100_YOPY $CONFIG_ARCH_SA1100

dep_tristate 'SA1100 USB function support' CONFIG_SA1100_USB $CONFIG_ARCH_SA1100
dep_tristate '  Support for SA11x0 USB network link function' CONFIG_SA1100_USB_NETLINK $CONFIG_SA1100_USB
dep_tristate '  Support for SA11x0 USB character device emulation' CONFIG_SA1100_USB_CHAR $CONFIG_SA1100_USB

dep_tristate 'SA1100 Generic PIO SSP support' CONFIG_SA1100_SSP $CONFIG_ARCH_SA1100

endmenu

mainmenu_option next_comment
comment 'AT91RM9200 Implementations'
dep_bool '  Atmel AT91RM9200 Development Board' CONFIG_ARCH_AT91RM9200DK $CONFIG_ARCH_AT91RM9200
dep_bool '  Cogent CSB337' CONFIG_MACH_CSB337 $CONFIG_ARCH_AT91RM9200
endmenu

mainmenu_option next_comment
comment 'CLPS711X/EP721X Implementations'
dep_bool '  AUTCPU12' CONFIG_ARCH_AUTCPU12 $CONFIG_ARCH_CLPS711X
dep_bool '  CDB89712' CONFIG_ARCH_CDB89712 $CONFIG_ARCH_CLPS711X
dep_bool '  CLEP7312' CONFIG_ARCH_CLEP7312 $CONFIG_ARCH_CLPS711X
dep_bool '  EDB7211' CONFIG_ARCH_EDB7211 $CONFIG_ARCH_CLPS711X
dep_bool '  FORTUNET' CONFIG_ARCH_FORTUNET $CONFIG_ARCH_CLPS711X
dep_bool '  GUIDEA07' CONFIG_ARCH_GUIDEA07 $CONFIG_ARCH_CLPS711X
dep_bool '  P720T' CONFIG_ARCH_P720T $CONFIG_ARCH_CLPS711X


# XXX Maybe these should indicate register compatibility
# instead of being mutually exclusive.
if [ "$CONFIG_ARCH_EDB7211" = "y" ]; then
   define_bool CONFIG_ARCH_EP7211 y
else
   define_bool CONFIG_ARCH_EP7211 n
fi
if [ "$CONFIG_ARCH_P720T" = "y" ]; then
   define_bool CONFIG_ARCH_EP7212 y
else
   define_bool CONFIG_ARCH_EP7212 n
fi

if [ "$CONFIG_ARCH_EP7211" = "y" -o \
     "$CONFIG_ARCH_EP7212" = "y" ]; then
   bool '  EP72xx ROM boot' CONFIG_EP72XX_ROM_BOOT
fi

if [ "$CONFIG_ARCH_GUIDEA07" = "y" ]; then
   define_bool CONFIG_ARCH_CDB89712 y
fi

endmenu

# Definitions to make life easier
if [ "$CONFIG_ARCH_ARCA5K" = "y" -o \
     "$CONFIG_ARCH_RPC" = "y" ]; then
   define_bool CONFIG_ARCH_ACORN y
else
   define_bool CONFIG_ARCH_ACORN n
fi

if [ "$CONFIG_ARCH_CAMELOT" = "y" ]; then
   define_bool CONFIG_PLD y
else
   define_bool CONFIG_PLD n
fi

#####################################################################
# Footbridge support
if [ "$CONFIG_ARCH_CO285" = "y" -o \
     "$CONFIG_ARCH_FOOTBRIDGE" = "y" ]; then
   define_bool CONFIG_FOOTBRIDGE y
else
   define_bool CONFIG_FOOTBRIDGE n
fi
if [ "$CONFIG_ARCH_CATS" = "y" -o \
     "$CONFIG_ARCH_EBSA285_HOST" = "y" -o \
     "$CONFIG_ARCH_NETWINDER" = "y" -o \
     "$CONFIG_ARCH_PERSONAL_SERVER" = "y" ]; then
   define_bool CONFIG_FOOTBRIDGE_HOST y
else
   define_bool CONFIG_FOOTBRIDGE_HOST n
fi
if [ "$CONFIG_ARCH_CO285" = "y" -o \
     "$CONFIG_ARCH_EBSA285_ADDIN" = "y" ]; then
   define_bool CONFIG_FOOTBRIDGE_ADDIN y
else
   define_bool CONFIG_FOOTBRIDGE_ADDIN n
fi
if [ "$CONFIG_ARCH_EBSA285_HOST" = "y" -o \
     "$CONFIG_ARCH_EBSA285_ADDIN" = "y" ]; then
   define_bool CONFIG_ARCH_EBSA285 y
fi

#####################################################################
# SA1111 support
if [ "$CONFIG_ASSABET_NEPONSET" = "y" -o \
     "$CONFIG_SA1100_ACCELENT" = "y" -o \
     "$CONFIG_SA1100_ADSAGC" = "y" -o \
     "$CONFIG_SA1100_ADSBITSY" = "y" -o \
     "$CONFIG_SA1100_ADSBITSYPLUS" = "y" -o \
     "$CONFIG_SA1100_BADGE4" = "y" -o \
     "$CONFIG_SA1100_CONSUS" = "y" -o \
     "$CONFIG_SA1100_GRAPHICSMASTER" = "y" -o \
     "$CONFIG_SA1100_JORNADA720" = "y" -o \
     "$CONFIG_SA1100_PFS168" = "y" -o \
     "$CONFIG_SA1100_PT_SYSTEM3" = "y" -o \
     "$CONFIG_SA1100_XP860" = "y" ]; then
   define_bool CONFIG_SA1111 y
   define_int CONFIG_FORCE_MAX_ZONEORDER 9
fi

if [ "$CONFIG_ARCH_CAMELOT" = "y" ]; then
  choice 'EPXA system type' \
         "EPXA10DB CONFIG_EPXA10DB \
          EPXA1DB  CONFIG_EPXA1DB" EPXA10DB

if [ "$CONFIG_EPXA10DB" = "y" ]; then
  choice 'EPXA10B version' \
         "SDR CONFIG_EPXA10DB_R2 \
          DDR CONFIG_EPXA10DB_R3" DDR
fi

   comment 'PLD hotswap support'
   define_bool CONFIG_PLD y
   dep_bool 'Support for PLD device hotplugging' CONFIG_PLD_HOTSWAP $CONFIG_EXPERIMENTAL
fi

comment 'Processor Type'

# Figure out whether this system uses 26-bit or 32-bit CPUs.
if [ "$CONFIG_ARCH_ARCA5K" = "y" ]; then
   define_bool CONFIG_CPU_32 n
   define_bool CONFIG_CPU_26 y
   bool '2MB physical memory' CONFIG_PAGESIZE_16
else
   define_bool CONFIG_CPU_32 y
   define_bool CONFIG_CPU_26 n
fi

# Select CPU types depending on the architecture selected.  This selects
# which CPUs we support in the kernel image, and the compiler instruction
# optimiser behaviour.

# ARM610
if [ "$CONFIG_ARCH_RPC" = "y" ]; then
   bool 'Support ARM610 processor' CONFIG_CPU_ARM610
else
   define_bool CONFIG_CPU_ARM610 n
fi

# ARM710
if [ "$CONFIG_ARCH_CLPS7500" = "y" -o \
     "$CONFIG_ARCH_RISCSTATION" = "y" ]; then
   define_bool CONFIG_CPU_ARM710 y
else
   if [ "$CONFIG_ARCH_RPC" = "y" ]; then
      bool 'Support ARM710 processor' CONFIG_CPU_ARM710
   else
      define_bool CONFIG_CPU_ARM710 n
   fi
fi

# ARM720T
if [ "$CONFIG_ARCH_CLPS711X" = "y" -o \
     "$CONFIG_ARCH_L7200"    = "y" -o \
     "$CONFIG_ARCH_SSA"      = "y" -o \
     "$CONFIG_ARCH_CDB89712" = "y" ]; then
   define_bool CONFIG_CPU_ARM720T y
else
   if [ "$CONFIG_ARCH_INTEGRATOR" = "y" ]; then
      bool 'Support ARM720T processor' CONFIG_CPU_ARM720T
   else
      define_bool CONFIG_CPU_ARM720T n
   fi
fi

# ARM920T
if [ "$CONFIG_ARCH_MX1ADS" = "y" -o \
     "$CONFIG_ARCH_AT91RM9200" = "y" ]; then
   define_bool CONFIG_CPU_ARM920T y
else
   if [ "$CONFIG_ARCH_INTEGRATOR" = "y" -o \
	"$CONFIG_ARCH_OMAHA" = "y" ]; then
      bool 'Support ARM920T processor' CONFIG_CPU_ARM920T
   else
      define_bool CONFIG_CPU_ARM920T n
   fi
fi


# ARM922T
if [ "$CONFIG_ARCH_CAMELOT" = "y" ]; then
   define_bool CONFIG_CPU_ARM922T y
else
   if [ "$CONFIG_ARCH_INTEGRATOR" = "y" ]; then
      bool 'Support ARM922T(Excalibur) processor' CONFIG_ARM922T
   else
      define_bool CONFIG_CPU_ARM922T n
   fi
fi

# ARM926T

if [ "$CONFIG_ARCH_PNX0106" = "y" ]; then
   define_bool CONFIG_CPU_ARM926T y
else
   if [ "$CONFIG_ARCH_INTEGRATOR" = "y" ]; then
      bool 'Support ARM926TEJ-S processor' CONFIG_CPU_ARM926T
   else
      define_bool CONFIG_CPU_ARM926T n
   fi
fi

# ARM1020
if [ "$CONFIG_ARCH_INTEGRATOR" = "y" ]; then
   bool 'Support ARM1020T (Rev0) processor' CONFIG_CPU_ARM1020
else
    define_bool CONFIG_CPU_ARM1020 n
fi

# ARM1020E
if [ "$CONFIG_ARCH_INTEGRATOR" = "y" ]; then
   bool 'Support ARM1020E (Rev1) processor' CONFIG_CPU_ARM1020E
else
    define_bool CONFIG_CPU_ARM1020E n
fi

# ARM1022
if [ "$CONFIG_ARCH_INTEGRATOR" = "y" ]; then
   bool 'Support ARM1022 processor' CONFIG_CPU_ARM1020E
else
    define_bool CONFIG_CPU_ARM1022 n
fi

# ARM1026EJ-S
if [ "$CONFIG_ARCH_INTEGRATOR" = "y" ]; then
   bool 'Support ARM1026EJ-S processor' CONFIG_CPU_ARM1026
else
   define_bool CONFIG_CPU_ARM1026 n
fi

# SA110
if [ "$CONFIG_ARCH_EBSA110"  = "y" -o "$CONFIG_FOOTBRIDGE" = "y" -o \
     "$CONFIG_ARCH_TBOX"     = "y" -o "$CONFIG_ARCH_SHARK" = "y" -o \
     "$CONFIG_ARCH_NEXUSPCI" = "y" -o "$CONFIG_ARCH_ANAKIN" = "y" ]; then
   define_bool CONFIG_CPU_SA110 y
else
   if [ "$CONFIG_ARCH_RPC" = "y" ]; then
      bool 'Support StrongARM(R) SA-110 processor' CONFIG_CPU_SA110
   else
      define_bool CONFIG_CPU_SA110 n
   fi
fi

# SA1100
if [ "$CONFIG_ARCH_SA1100" = "y" ]; then
   define_bool CONFIG_CPU_SA1100 y
else
   define_bool CONFIG_CPU_SA1100 n
fi

# Figure out what processor architecture version we should be using.
# This defines the compiler instruction set which depends on the machine type.

if [ "$CONFIG_ARCH_RPC"         = "y" -o \
     "$CONFIG_ARCH_RISCSTATION" = "y" -o \
     "$CONFIG_ARCH_CLPS7500"    = "y" ]; then
   define_bool CONFIG_CPU_32v3 y
else
   define_bool CONFIG_CPU_32v3 n
fi
if [ "$CONFIG_ARCH_EBSA110"    = "y" -o "$CONFIG_FOOTBRIDGE"    = "y" -o \
     "$CONFIG_ARCH_TBOX"       = "y" -o "$CONFIG_ARCH_SHARK"    = "y" -o \
     "$CONFIG_ARCH_NEXUSPCI"   = "y" -o "$CONFIG_ARCH_CLPS711X" = "y" -o \
     "$CONFIG_ARCH_INTEGRATOR" = "y" -o "$CONFIG_ARCH_SA1100"   = "y" -o \
     "$CONFIG_ARCH_SSA"        = "y" -o \
     "$CONFIG_ARCH_L7200"      = "y" -o "$CONFIG_ARCH_ANAKIN"	= "y" -o \
     "$CONFIG_ARCH_CAMELOT"    = "y" -o "$CONFIG_ARCH_MX1ADS"   = "y" -o \
     "$CONFIG_ARCH_OMAHA"      = "y" -o "$CONFIG_ARCH_AT91RM9200" = "y" ]; then
   define_bool CONFIG_CPU_32v4 y
else
   define_bool CONFIG_CPU_32v4 n
fi

if [ "$CONFIG_ARCH_PNX0106"	= "y" ]; then
   define_bool CONFIG_CPU_32v5 y
else
   define_bool CONFIG_CPU_32v5 n
fi


comment 'Processor Features'

if [ "$CONFIG_CPU_ARM720T" = "y" -o "$CONFIG_CPU_ARM920T" = "y" -o \
     "$CONFIG_CPU_ARM922T" = "y" -o "$CONFIG_CPU_ARM926T" = "y" -o \
     "$CONFIG_CPU_ARM1020" = "y" -o "$CONFIG_CPU_ARM1020E" = "y" -o \
     "$CONFIG_CPU_ARM1022" = "y" -o "$CONFIG_CPU_ARM1026" = "y" ]; then
   dep_bool 'Enable workaround for lost writes (Arm Errata 319664)' CONFIG_ARCH_LOST_WRITES
   dep_bool 'Support Thumb instructions (EXPERIMENTAL)' CONFIG_ARM_THUMB $CONFIG_EXPERIMENTAL
fi
if [ "$CONFIG_CPU_ARM920T" = "y" -o "$CONFIG_CPU_ARM922T" = "y" -o \
     "$CONFIG_CPU_ARM926T" = "y" -o "$CONFIG_CPU_ARM1020" = "y" -o \
     "$CONFIG_CPU_ARM1020E" = "y" -o "$CONFIG_CPU_ARM1022" = "y" -o \
     "$CONFIG_CPU_ARM1026" = "y" ]; then
   bool 'Disable I-Cache' CONFIG_CPU_ICACHE_DISABLE
   bool 'Disable D-Cache' CONFIG_CPU_DCACHE_DISABLE
   if [ "$CONFIG_CPU_DCACHE_DISABLE" = "n" ]; then
      bool 'Force write through D-cache' CONFIG_CPU_DCACHE_WRITETHROUGH
   fi
fi
if [ "$CONFIG_CPU_ARM926T" = "y" -o "$CONFIG_CPU_ARM1020" = "y" -o \
     "$CONFIG_CPU_ARM1020E" = "y" -o "$CONFIG_CPU_ARM1022" = "y" -o \
     "$CONFIG_CPU_ARM1026" = "y" ]; then
   if [ "$CONFIG_CPU_ICACHE_DISABLE" = "n" -o "$CONFIG_CPU_DCACHE_DISABLE" = "n" ]; then
      bool 'Round robin I and D cache replacement algorithm' CONFIG_CPU_CACHE_ROUND_ROBIN
   fi
fi
if [ "$CONFIG_CPU_ARM1020" = "y" -o "$CONFIG_CPU_ARM1020E" = "y" -o \
    "$CONFIG_CPU_ARM1026" = "y" -o "$CONFIG_CPU_ARM1022" = "y" ]; then
   bool 'Disable branch prediction' CONFIG_CPU_BPREDICT_DISABLE
fi


# Select various configuration options depending on the machine type
if [ "$CONFIG_ARCH_EDB7211" = "y" -o \
     "$CONFIG_ARCH_SA1100" = "y" -o \
     "$CONFIG_ARCH_RISCSTATION" = "y" ]; then
   define_bool CONFIG_DISCONTIGMEM y
else
   define_bool CONFIG_DISCONTIGMEM n
fi

endmenu

mainmenu_option next_comment
comment 'General setup'

# Now handle the bus types
if [ "$CONFIG_ARCH_FTVPCI" = "y" -o \
     "$CONFIG_ARCH_SHARK" = "y" -o \
     "$CONFIG_FOOTBRIDGE_HOST" = "y" ]; then
   define_bool CONFIG_PCI y
else
   if [ "$CONFIG_ARCH_INTEGRATOR" = "y" ]; then
      bool 'PCI support' CONFIG_PCI_INTEGRATOR
      define_bool CONFIG_PCI $CONFIG_PCI_INTEGRATOR
   else
      define_bool CONFIG_PCI n
   fi
fi

if [ "$CONFIG_FOOTBRIDGE_HOST" = "y" -o \
     "$CONFIG_ARCH_SHARK" = "y" -o \
     "$CONFIG_ARCH_CLPS7500" = "y" -o \
     "$CONFIG_ARCH_RISCSTATION" = "y" -o \
     "$CONFIG_ARCH_EBSA110" = "y" -o \
     "$CONFIG_ARCH_CDB89712" = "y" -o \
     "$CONFIG_ARCH_EDB7211" = "y" -o \
     "$CONFIG_ARCH_SA1100" = "y" ]; then
   define_bool CONFIG_ISA y
else
   define_bool CONFIG_ISA n
fi

if [ "$CONFIG_FOOTBRIDGE_HOST" = "y" -o \
     "$CONFIG_ARCH_SHARK" = "y" ]; then
   define_bool CONFIG_ISA_DMA y
else
   define_bool CONFIG_ISA_DMA n
fi

# Compressed boot loader in ROM.  Yes, we really want to ask about
# TEXT and BSS so we preserve their values in the config files.
bool 'Compressed boot loader in ROM/flash' CONFIG_ZBOOT_ROM
hex 'Compressed ROM boot loader base address' CONFIG_ZBOOT_ROM_TEXT 0
hex 'Compressed ROM boot loader BSS address' CONFIG_ZBOOT_ROM_BSS 0

if [ "$CONFIG_ARCH_SA1100" = "y" -o \
     "$CONFIG_ARCH_INTEGRATOR" = "y" ]; then
   dep_bool 'Support CPU clock change (EXPERIMENTAL)' CONFIG_CPU_FREQ $CONFIG_EXPERIMENTAL
fi

source drivers/pci/Config.in
bool 'Support for hot-pluggable devices' CONFIG_HOTPLUG
if [ "$CONFIG_HOTPLUG" = "y" ]; then
   source drivers/pcmcia/Config.in
else
   define_bool CONFIG_PCMCIA n
fi
if [ "$CONFIG_SA1100_ACCELENT" = "y" ]; then
   if [ "$CONFIG_PCMCIA" != "n" ]; then
      bool '  Use second PCMCIA/CF slot (disables on-board IDE)' CONFIG_SA_PCMCIA_SLOT_1 y
   fi
fi
bool 'Networking support' CONFIG_NET
bool 'System V IPC' CONFIG_SYSVIPC
bool 'BSD Process Accounting' CONFIG_BSD_PROCESS_ACCT
bool 'Sysctl support' CONFIG_SYSCTL
comment 'At least one math emulation must be selected'
tristate 'NWFPE math emulation' CONFIG_FPE_NWFPE
if [ "$CONFIG_FPE_NWFPE" != "n" ]; then
  bool '  Support extended precision' CONFIG_FPE_NWFPE_XP
fi
if [ "$CONFIG_CPU_26" = "n" ]; then
   dep_tristate 'FastFPE math emulation (EXPERIMENTAL)' CONFIG_FPE_FASTFPE $CONFIG_EXPERIMENTAL
fi
choice 'Kernel core (/proc/kcore) format' \
	"ELF		CONFIG_KCORE_ELF	\
	 A.OUT		CONFIG_KCORE_AOUT" ELF
tristate 'Kernel support for a.out binaries' CONFIG_BINFMT_AOUT
tristate 'Kernel support for ELF binaries' CONFIG_BINFMT_ELF
tristate 'Kernel support for MISC binaries' CONFIG_BINFMT_MISC
dep_bool 'Power Management support (experimental)' CONFIG_PM $CONFIG_EXPERIMENTAL
dep_tristate 'RISC OS personality' CONFIG_ARTHUR $CONFIG_CPU_32
string 'Default kernel command string' CONFIG_CMDLINE ""

if [ "$CONFIG_ARCH_NETWINDER" = "y" -o  \
     "$CONFIG_ARCH_EBSA110" = "y" -o    \
     "$CONFIG_ARCH_EBSA285" = "y" -o    \
     "$CONFIG_ARCH_FTVPCI" = "y" -o     \
     "$CONFIG_ARCH_SHARK" = "y" -o      \
     "$CONFIG_ARCH_CO285" = "y" -o      \
     "$CONFIG_ARCH_SA1100" = "y" -o     \
     "$CONFIG_ARCH_INTEGRATOR" = "y" -o \
     "$CONFIG_ARCH_CDB89712" = "y" -o   \
     "$CONFIG_ARCH_P720T" = "y" -o	\
     "$CONFIG_ARCH_SSA" = "y" -o	\
     "$CONFIG_ARCH_PNX0106" = "y" -o	\
     "$CONFIG_ARCH_OMAHA" = "y" -o	\
     "$CONFIG_ARCH_AT91RM9200" = "y" ]; then
   bool 'Timer and CPU usage LEDs' CONFIG_LEDS
   if [ "$CONFIG_LEDS" = "y" ]; then
      if [ "$CONFIG_ARCH_NETWINDER" = "y" -o  \
	   "$CONFIG_ARCH_EBSA285" = "y" -o    \
	   "$CONFIG_ARCH_SHARK" = "y" -o      \
	   "$CONFIG_ARCH_CO285" = "y" -o      \
	   "$CONFIG_ARCH_SA1100" = "y" -o     \
           "$CONFIG_ARCH_INTEGRATOR" = "y" -o \
	   "$CONFIG_ARCH_P720T" = "y" -o      \
	   "$CONFIG_ARCH_SSA" = "y" -o        \
	   "$CONFIG_ARCH_PNX0106" = "y" -o    \
	   "$CONFIG_ARCH_OMAHA" = "y" -o      \
	   "$CONFIG_ARCH_AT91RM9200" = "y" ]; then
         bool '  Timer LED' CONFIG_LEDS_TIMER
         bool '  CPU usage LED' CONFIG_LEDS_CPU
      fi
      if [ "$CONFIG_ARCH_EBSA110" = "y" ]; then
         define_bool CONFIG_LEDS_TIMER y
      fi
   fi
fi
if [ "$CONFIG_ARCH_SA1100" = "y" ]; then
   define_bool CONFIG_ALIGNMENT_TRAP y
else
   if [ "$CONFIG_CPU_32" = "y" -a "$CONFIG_ARCH_EBSA110" != "y" ]; then
      bool 'Kernel-mode alignment trap handler' CONFIG_ALIGNMENT_TRAP
   else
      define_bool CONFIG_ALIGNMENT_TRAP n
   fi
fi
endmenu

source drivers/parport/Config.in

if [ "$CONFIG_ALIGNMENT_TRAP" = "y" ]; then
  source drivers/mtd/Config.in
else
  define_bool CONFIG_MTD n
fi

source drivers/pnp/Config.in
source drivers/block/Config.in
source drivers/md/Config.in

if [ "$CONFIG_ARCH_ACORN" = "y" ]; then
   source drivers/acorn/block/Config.in
fi

if [ "$CONFIG_NET" = "y" ]; then
   source net/Config.in

   mainmenu_option next_comment
   comment 'Network device support'

   bool 'Network device support' CONFIG_NETDEVICES
   if [ "$CONFIG_NETDEVICES" = "y" ]; then
      source drivers/net/Config.in
   fi
   endmenu

   source net/ax25/Config.in

   source net/irda/Config.in
fi

mainmenu_option next_comment
comment 'ATA/ATAPI/MFM/RLL support'

tristate 'ATA/ATAPI/MFM/RLL support' CONFIG_IDE

if [ "$CONFIG_IDE" != "n" ]; then
  source drivers/ide/Config.in
else
  define_bool CONFIG_BLK_DEV_HD n
fi
endmenu

mainmenu_option next_comment
comment 'SCSI support'

tristate 'SCSI support' CONFIG_SCSI

if [ "$CONFIG_SCSI" != "n" ]; then
   source drivers/scsi/Config.in
fi
endmenu

if [ "$CONFIG_ARCH_CLPS711X" = "y" ]; then
   # This is _meant_ to be ssi _not_ scsi.  It is not a spelling error.
   source drivers/ssi/Config.in
fi

source drivers/ieee1394/Config.in

source drivers/message/i2o/Config.in

mainmenu_option next_comment
comment 'ISDN subsystem'

tristate 'ISDN support' CONFIG_ISDN
if [ "$CONFIG_ISDN" != "n" ]; then
   source drivers/isdn/Config.in
fi
endmenu

#
# input before char - char/joystick depends on it. As does USB.
#
source drivers/input/Config.in

source drivers/char/Config.in
if [ "$CONFIG_ARCH_ACORN" = "y" -a \
     "$CONFIG_BUSMOUSE" = "y" ]; then
   if [ "$CONFIG_ARCH_RPC" != "y" ]; then
      define_bool CONFIG_KBDMOUSE y
   else
      define_bool CONFIG_RPCMOUSE y
   fi
fi

source drivers/media/Config.in

source fs/Config.in

if [ "$CONFIG_VT" = "y" ]; then
   mainmenu_option next_comment
   comment 'Console drivers'
   # Select the keyboard type for this architecture.
   if [ "$CONFIG_FOOTBRIDGE_HOST" = "y" -o \
        "$CONFIG_ARCH_CLPS7500" = "y" -o   \
        "$CONFIG_ARCH_SHARK" = "y" ]; then
      define_bool CONFIG_PC_KEYB y
   fi
   if [ "$CONFIG_ARCH_INTEGRATOR" = "y" ]; then
      define_bool CONFIG_KMI_KEYB y
      define_bool CONFIG_KMI_MOUSE y
   fi
   if [ "$CONFIG_ARCH_L7200" = "y" ]; then
      define_bool CONFIG_L7200_KEYB y
   fi

   # Do we use the PC-type keyboard map?
   if [ "$CONFIG_FOOTBRIDGE_HOST" = "y" -o \
        "$CONFIG_ARCH_SHARK" = "y" -o      \
        "$CONFIG_ARCH_SA1100" = "y" -o     \
        "$CONFIG_ARCH_INTEGRATOR" = "y" -o \
        "$CONFIG_ARCH_TBOX" = "y" -o       \
        "$CONFIG_ARCH_CLPS7500" = "y" -o   \
        "$CONFIG_ARCH_P720T" = "y" -o      \
        "$CONFIG_ARCH_ANAKIN" = "y" -o      \
	"$CONFIG_ARCH_MX1ADS" = "y" ]; then
      define_bool CONFIG_PC_KEYMAP y
   fi
   if [ "$CONFIG_ARCH_ACORN" != "y" -a "$CONFIG_ARCH_EBSA110" != "y" -a "$CONFIG_ARCH_RISCSTATION" != "y" ]; then
      bool 'VGA text console' CONFIG_VGA_CONSOLE
   fi
   source drivers/video/Config.in
   endmenu
fi

if [ "$CONFIG_ARCH_ACORN" = "y" -o \
     "$CONFIG_ARCH_CLPS7500" = "y" -o \
     "$CONFIG_ARCH_RISCSTATION" = "y" -o \
     "$CONFIG_ARCH_TBOX" = "y" -o \
     "$CONFIG_ARCH_SHARK" = "y" -o \
     "$CONFIG_ARCH_SA1100" = "y" -o \
     "$CONFIG_ARCH_SSA" = "y" -o \
     "$CONFIG_ARCH_PNX0106" = "y" -o \
     "$CONFIG_PCI" = "y" ]; then
   mainmenu_option next_comment
   comment 'Sound'

   tristate 'Sound support' CONFIG_SOUND
   if [ "$CONFIG_SOUND" != "n" ]; then
      source drivers/sound/Config.in
   fi
   endmenu
fi

source drivers/misc/Config.in

source drivers/usb/Config.in

if [ "$CONFIG_EXPERIMENTAL" = "y" ]; then
   source net/bluetooth/Config.in
fi

mainmenu_option next_comment
comment 'Kernel hacking'

# RMK wants arm kernels compiled with frame pointers.
# If you know what you are doing and are willing to live without stack traces,
# you can get a slightly smaller kernel by setting this option to n, but then
# RMK will have to kill you ;).
bool 'Use Frame Pointer' CONFIG_FRAME_POINTER
bool 'Verbose user fault messages' CONFIG_DEBUG_USER
bool 'Include debugging information in kernel binary' CONFIG_DEBUG_INFO
dep_bool 'Disable pgtable cache' CONFIG_NO_PGT_CACHE $CONFIG_CPU_26

bool 'Kernel debugging' CONFIG_DEBUG_KERNEL
dep_bool '  Debug memory allocations' CONFIG_DEBUG_SLAB $CONFIG_DEBUG_KERNEL
dep_bool '  Magic SysRq key' CONFIG_MAGIC_SYSRQ $CONFIG_DEBUG_KERNEL
dep_bool '  Spinlock debugging' CONFIG_DEBUG_SPINLOCK $CONFIG_DEBUG_KERNEL
dep_bool '  Wait queue debugging' CONFIG_DEBUG_WAITQ $CONFIG_DEBUG_KERNEL
dep_bool '  Verbose BUG() reporting (adds 70K)' CONFIG_DEBUG_BUGVERBOSE $CONFIG_DEBUG_KERNEL
dep_bool '  Verbose kernel error messages' CONFIG_DEBUG_ERRORS $CONFIG_DEBUG_KERNEL
dep_bool '  Kernel panic postmortem debugging' CONFIG_DEBUG_PANIC_POSTMORTEM $CONFIG_DEBUG_KERNEL
# These options are only for real kernel hackers who want to get their hands dirty.
dep_bool '  Kernel low-level debugging functions' CONFIG_DEBUG_LL $CONFIG_DEBUG_KERNEL
dep_bool '    Kernel low-level debugging messages via footbridge serial port' CONFIG_DEBUG_DC21285_PORT $CONFIG_DEBUG_LL $CONFIG_FOOTBRIDGE
dep_bool '    Kernel low-level debugging messages via UART2' CONFIG_DEBUG_CLPS711X_UART2 $CONFIG_DEBUG_LL $CONFIG_ARCH_CLPS711X
endmenu

source lib/Config.in
```
